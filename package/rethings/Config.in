## package/rethings/Config.in
```kconfig
menuconfig BR2_PACKAGE_RETHINGS
	bool "rethings"
	select BR2_PACKAGE_HOST_DTC
	help
	  ReTerminal, ReTerminal DM, ReComputer DTS files that may be useful on Nerves systems.
```
